## conf/machine/bug.conf
```bitbake
#@TYPE: Machine
#@NAME: BUG 1.x
#@DESCRIPTION: Machine configuration for the BUG 1.x board (imx31 based)
TARGET_ARCH = "arm"

PREFERRED_PROVIDER_virtual/xserver = "xserver-xorg"
XSERVER = "xserver-xorg \
           xf86-input-evdev \
           xf86-input-mouse \
           xf86-video-fbdev \
           xf86-input-keyboard"

#MACHINE_EXTRA_RRECOMMENDS = "marvell-gspi-fw marvell-sdio-fw kernel-modules"
MACHINE_ESSENTIAL_EXTRA_RDEPENDS += "kernel"

# Only has DVI connector for external screen
GUI_MACHINE_CLASS = "smallscreen"

require conf/machine/include/tune-arm1136jf-s.inc
MACHINE_KERNEL_PR = "r0"

PREFERRED_PROVIDER_virtual/kernel = "linux-dummy"

IMAGE_FSTYPES += "tar.bz2"

SERIAL_CONSOLE = "115200 ttymxc4"

MACHINE_FEATURES = "kernel26 screen apm usbgadget usbhost vfat alsa"
```

## conf/machine/bug20.conf
```bitbake
#@TYPE: Machine
#@NAME: BUG 2.0
#@DESCRIPTION: Machine configuration for the BUG 2.0 board (OMAP3530 based)
TARGET_ARCH = "arm"

PREFERRED_PROVIDER_virtual/xserver = "xserver-xorg"
XSERVER = "xserver-xorg \
           xf86-input-evdev \
           xf86-input-mouse \
           xf86-video-omapfb \
           xf86-input-keyboard"

MACHINE_EXTRA_RRECOMMENDS = "marvell-gspi-fw marvell-sdio-fw kernel-modules"

# Only has DVI connector for external screen
GUI_MACHINE_CLASS = "bigscreen"

# If no u-boot and x-load recipes are needed we can use the following two lines
# directly instead of omap3.inc
#SOC_FAMILY = "omap3"
#require conf/machine/include/tune-cortexa8.inc

require conf/machine/include/omap3.inc

UBOOT_MACHINE = "omap3_bug_config"
PREFERRED_VERSION_u-boot = "bsp"

# We don't provide a bug20 x-load config yet
XLOAD_MACHINE = "omap3530beagle_config"

PREFERRED_PROVIDER_virtual/kernel = "linux-bug20-linaro"

IMAGE_FSTYPES += "tar.bz2"

# Needed for newer kernels
#SERIAL_CONSOLE = "115200 ttyO2"
SERIAL_CONSOLE = "115200 ttyS2"

MACHINE_FEATURES = "kernel26 screen apm usbgadget usbhost vfat alsa"
```
